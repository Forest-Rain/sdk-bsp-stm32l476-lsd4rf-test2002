## drivers/Kconfig
```kconfig
menu "Hardware Drivers Config"
config SOC_STM32L476VG
    bool
    select SOC_SERIES_STM32L4
    select RT_USING_COMPONENTS_INIT
    default y

config SOC_SERIES_STM32L4
    bool
    select ARCH_ARM_CORTEX_M4
    select SOC_FAMILY_STM32

menu "Board extended module"

endmenu

menu "Onboard Peripheral"

    config BSP_USING_USB_TO_USART
        bool "Enable Debuger USART (uart2)"
        select BSP_USING_UART
        select BSP_USING_UART2
        default n
endmenu

menu "On-chip Peripheral"

    config BSP_USING_GPIO
        bool "Enable GPIO"
        select RT_USING_PIN
        default y

    menuconfig BSP_USING_UART
        bool "Enable UART"
        default n
        select RT_USING_SERIAL
        select RT_SERIAL_USING_DMA
        if BSP_USING_UART
            config BSP_USING_UART1
                bool "Enable UART1"
                default n

            config BSP_UART1_RX_USING_DMA
                bool "Enable UART1 RX DMA"
                depends on BSP_USING_UART1 && RT_SERIAL_USING_DMA
                default n

            config BSP_UART1_TX_USING_DMA
                bool "Enable UART1 TX DMA"
                depends on BSP_USING_UART1 && RT_SERIAL_USING_DMA
                default n
                
            config BSP_USING_UART3
                bool "Enable UART3"
                default n
                
            config BSP_USING_UART4
                bool "Enable UART4"
                default n
                
            config BSP_USING_UART6
                bool "Enable UART6"
                default n
        endif

    menuconfig BSP_USING_SPI
        bool "Enable SPI"
        default n
        select RT_USING_SPI
        if BSP_USING_SPI
            config BSP_USING_SPI1
                bool "Enable SPI1"
                default n
            config BSP_USING_SPI2
                bool "Enable SPI2"
                default n
            config BSP_USING_SPI3
                bool "Enable SPI3"
                default n
            config BSP_USING_SPI4
                bool "Enable SPI4"
                default n
        endif
    menuconfig BSP_USING_I2C
        bool "Enable I2C BUS (software simulation)"
        select RT_USING_I2C
        select RT_USING_I2C_BITOPS
        select RT_USING_PIN
        default n
        if BSP_USING_I2C
            menuconfig BSP_USING_I2C1
                bool "Enable I2C1 BUS (i2c1)"
                default n
        endif

    menuconfig BSP_USING_TIM
        bool "Enable timer"
        default n
        select RT_USING_HWTIMER
        if BSP_USING_TIM
            config BSP_USING_TIM13
                bool "Enable TIM13"
                default n
        endif

    menuconfig BSP_USING_PWM
        bool "Enable PWM"
        default n
        select RT_USING_PWM
        if BSP_USING_PWM
        menuconfig BSP_USING_PWM5
            bool "Enable Timer5 output pwm"
            default n
            if BSP_USING_PWM5
                config BSP_USING_PWM5_CH1
                    bool "Enable PWM5 channel1"
                    default n
            endif
        config SAMPLES_USING_PWM
            bool "SAMPLE PWM5 channel1"
            default n
        endif

    config BSP_USING_ONCHIP_RTC
        bool "Enable Onchip RTC"
        select RT_USING_RTC
        default n
endmenu

endmenu

menu "External Libraries"

endmenu
```
